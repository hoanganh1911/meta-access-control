## conf/layer.conf
```bitbake
# We have a conf and classes directory, add to BBPATH
BBPATH .= ":${LAYERDIR}"

# We have recipes-* directories, add to BBFILES
BBFILES += "${LAYERDIR}/recipes-*/*/*.bb \
            ${LAYERDIR}/recipes-*/*/*.bbappend"

BBFILE_COLLECTIONS += "meta-access-control"
BBFILE_PATTERN_meta-access-control = "^${LAYERDIR}/"
BBFILE_PRIORITY_meta-access-control = "6"

LAYERDEPENDS_meta-access-control = "core"
LAYERSERIES_COMPAT_meta-access-control = "scarthgap"

TEZI_EXTERNAL_KERNEL_DEVICETREE_BOOT:verdin-imx8mp = " \
    verdin-imx8mp_ov5640_overlay.dtbo \
    verdin-imx8mp_wm8904_overlay.dtbo \
    verdin-imx8mp_panel-cap-touch-7inch-dsi_overlay.dtbo \
    verdin-imx8mp_opt3001_overlay.dtbo \
    verdin-imx8mp_vl53l5x_overlay.dtbo \
    verdin-imx8mp_atecc608a_overlay.dtbo \
    verdin-imx8mp_hd3ss3220_overlay.dtbo \
    verdin-imx8mp_sr602_overlay.dtbo \
    verdin-imx8mp_pn532_overlay.dtbo \
    verdin-imx8mp_ws2812_overlay.dtbo \
    verdin-imx8mp_rcwl1670_overlay.dtbo \
    verdin-imx8mp_tamper_switch_overlay.dtbo \
    verdin-imx8mp_lock_ctrl_overlay.dtbo \
    verdin-imx8mp_panic_overlay.dtbo \
"
```

## recipes-kernel/linux/linux-toradex/defconfig
```kconfig
# config HD3SS3220
CONFIG_TYPEC_HD3SS3220=m
CONFIG_USB_ROLE_SWITCH=y
CONFIG_TYPEC=y

# config OPT3001
CONFIG_OPT3001=y

# config OV5640
CONFIG_VIDEO_OV5640=y
CONFIG_VIDEO_IMX8_ISI=y
CONFIG_VIDEO_IMX8_ISI_M2M=y
CONFIG_VIDEO_IMX_MIPI_CSIS=y
CONFIG_VIDEO_IMX_CAPTURE=y
CONFIG_VIDEO_V4L2_SUBDEV_API=y

# CONFIG_NFC is not set
# CONFIG_NFC_DIGITAL is not set
# CONFIG_NFC_NCI is not set
# CONFIG_NFC_PN533 is not set
# CONFIG_NFC_PN532_UART is not set

# config VM8904
CONFIG_SND_SOC_WM8904=y
```

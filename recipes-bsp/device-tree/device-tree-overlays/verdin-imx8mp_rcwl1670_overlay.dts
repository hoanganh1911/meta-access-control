/dts-v1/;
/plugin/;

#include "imx8mp-pinfunc.h"

/ {
    compatible = "toradex,verdin-imx8mp";

    fragment@0 {
        target = <&iomuxc>;
        __overlay__ {
            pinctrl_uart2_rcwl1670: uart2rcwl1670grp {
                fsl,pins = <
                    MX8MP_IOMUXC_UART2_RXD__UART2_DCE_RX    0x140
                    MX8MP_IOMUXC_UART2_TXD__UART2_DCE_TX    0x140
                >;
            };
        };
    };

    fragment@1 {
        target = <&uart2>;
        __overlay__ {
            pinctrl-names = "default";
            pinctrl-0 = <&pinctrl_uart2_rcwl1670>;
            /delete-property/ uart-has-rtscts;
            status = "okay";
        };
    };
};

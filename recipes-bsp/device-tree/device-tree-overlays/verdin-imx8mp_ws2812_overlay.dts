/dts-v1/;
/plugin/;

#include "imx8mp-pinfunc.h"
#include <dt-bindings/gpio/gpio.h>

/ {
    compatible = "toradex,verdin-imx8mp";

    fragment@0 {
        target = <&iomuxc>;
        __overlay__ {
            pinctrl_led_strip: ledstripgrp {
                fsl,pins = <
                    MX8MP_IOMUXC_GPIO1_IO08__GPIO1_IO08          0x184 /* SODIMM 218 */
                >;
            };
        };
    };

    fragment@1 {
        target-path = "/";
        __overlay__ {
            ws2812 {
                compatible = "custom,ws2812-bitbang";
                pinctrl-names = "default";
                pinctrl-0 = <&pinctrl_led_strip>;
                led-gpios = <&gpio1 8 GPIO_ACTIVE_HIGH>;
                status = "okay";
            };
        };
    };
};

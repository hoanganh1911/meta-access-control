/dts-v1/;
/plugin/;

/ {
    compatible = "toradex,verdin-imx8mp";

    fragment@0 {
        target = <&i2c4>;
        __overlay__ {
            status = "okay";

            atecc608a@60 {
                compatible = "atmel,atecc608a";
                reg = <0x60>;
            };
        };
    };
};

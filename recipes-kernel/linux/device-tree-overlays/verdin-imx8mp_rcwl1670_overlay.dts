/dts-v1/;
/plugin/;

#include "imx8mp-pinfunc.h"

/ {
    compatible = "toradex,verdin-imx8mp";

    fragment@0 {
        target = <&iomuxc>;
        __overlay__ {
            pinctrl_rcwl1670: rcwl1670grp {
                fsl,pins = <
                    MX8MP_IOMUXC_UART2_TXD__GPIO5_IO25  0x146
                    MX8MP_IOMUXC_UART2_RXD__GPIO5_IO24  0x146
                >;
            };
        };
    };

    fragment@1 {
        target = <&uart2>;
        __overlay__ {
            status = "disabled";
        };
    };
};
